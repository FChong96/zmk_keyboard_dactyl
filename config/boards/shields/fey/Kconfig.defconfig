## config/boards/shields/fey/Kconfig.defconfig
```kconfig
# Copyright (c) 2020 Ryan Cross
# SPDX-License-Identifier: MIT

if SHIELD_FEY_LEFT

config ZMK_KEYBOARD_NAME
	default "Fey"

config ZMK_SPLIT_BLE_ROLE_CENTRAL
	default y

endif

if SHIELD_FEY_LEFT || SHIELD_FEY_RIGHT

config ZMK_SPLIT
	default y

endif
```

## config/boards/shields/fey/Kconfig.shield
```kconfig
# Copyright (c) 2020 The ZMK Contributors
# SPDX-License-Identifier: MIT

config SHIELD_FEY_LEFT
	def_bool $(shields_list_contains,fey_left)

config SHIELD_FEY_RIGHT
	def_bool $(shields_list_contains,fey_right)
```
