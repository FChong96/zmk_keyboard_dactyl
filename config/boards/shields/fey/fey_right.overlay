/*
 * Copyright (c) 2020 The ZMK Contributors
 *
 * SPDX-License-Identifier: MIT
 */

#include "fey.dtsi"

&default_transform {
	col-offset = <7>;
};

&kscan0 {
	col-gpios
		= <&pro_micro 16 GPIO_ACTIVE_HIGH>  // col 1
        , <&pro_micro 14 GPIO_ACTIVE_HIGH>  // col 2
		, <&pro_micro 15 GPIO_ACTIVE_HIGH>  // col 3
		, <&pro_micro 18 GPIO_ACTIVE_HIGH>  // col 4
		, <&pro_micro 19 GPIO_ACTIVE_HIGH>  // col 5
		, <&pro_micro 20 GPIO_ACTIVE_HIGH>  // col 6
		, <&pro_micro 21 GPIO_ACTIVE_HIGH>  // col 7
		;
};
